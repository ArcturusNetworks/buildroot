## board/arcturus/aarch64-ucimx93/br2-imx93-som144-parallel.its
```
/*
 * Copyright (C) 2018-2024, Arcturus Networks Inc.
 *
 * This file is licensed under the terms of the GNU General Public
 * License version 2.  This program is licensed "as is" without any
 * warranty of any kind, whether express or implied.
 */

/dts-v1/;

/ {
	description = "Image file for the Arcturus uCMX93-SOM144 Linux Kernel with ramdisk";
	#address-cells = <1>;

	images {
		kernel {
			description = "Linux kernel";
			data = /incbin/("Image.gz");
			type = "kernel";
			arch = "arm64";
			os = "linux";
			compression = "gzip";
			load = <0x80400000>;
			entry = <0x80400000>;
			hash {
				algo = "sha1";
			};
		};
		fdt {
			description = "Flattened Device Tree blob";
			data = /incbin/("ucimx93-som144-parallel.dtb");
			type = "flat_dt";
			arch = "arm64";
			compression = "none";
			load = <0x90000000>;
			hash {
				algo = "sha1";
			};
		};
		ramdisk {
			description = "Ramdisk";
			data = /incbin/("rootfs.cpio.gz");
			type = "ramdisk";
			arch = "arm64";
			os = "linux";
			compression = "gzip";
			hash {
				algo = "sha1";
			};
		};
	};

	configurations {
		default = "config1";
		config1 {
			kernel = "kernel";
			fdt = "fdt";
			ramdisk = "ramdisk";
			hash {
				algo = "sha1";
			};
		};
	};
};
```

## board/arcturus/aarch64-ucimx93/ucimx93-som144-ucevo20-lcd-s035.its
```
/*
 * Copyright (C) 2018-2023, Arcturus Networks Inc.
 *
 * This file is licensed under the terms of the GNU General Public
 * License version 2.  This program is licensed "as is" without any
 * warranty of any kind, whether express or implied.
 */

/dts-v1/;

/ {
	description = "Image file for the Arcturus uCMX93-SOM144 Linux Kernel with ramdisk";
	#address-cells = <1>;

	images {
		kernel {
			description = "Linux kernel";
			data = /incbin/("./arch/arm64/boot/Image.gz");
			type = "kernel";
			arch = "arm64";
			os = "linux";
			compression = "gzip";
			load = <0x80400000>;
			entry = <0x80400000>;
			hash {
				algo = "sha1";
			};
		};
		fdt {
			description = "Flattened Device Tree blob";
			data = /incbin/("./arch/arm64/boot/dts/arcturus/ucimx93-som144-ucevo20-lcd-s035.dts");
			type = "flat_dt";
			arch = "arm64";
			compression = "none";
			load = <0x90000000>;
			hash {
				algo = "sha1";
			};
		};
	};

	configurations {
		default = "config1";
		config1 {
			kernel = "kernel";
			fdt = "fdt";
			hash {
				algo = "sha1";
			};
		};
	};
};
```

## configs/arcturus_ucevo-imx93_r20_defconfig
```kconfig
BR2_aarch64=y
BR2_cortex_a55=y
BR2_ARM_FPU_VFPV4D16=y
BR2_PACKAGE_HOST_LINUX_HEADERS_CUSTOM_6_6=y
BR2_WGET="wget -nd -t 3 --no-check-certificate"
BR2_DL_DIR="$(TOPDIR)/.BR2_dl"
BR2_TARGET_GENERIC_HOSTNAME="ucevoimx93_r20"
BR2_TARGET_GENERIC_ISSUE="Welcome to uCEVO-IMX93 R.2.0"
BR2_TARGET_GENERIC_GETTY_PORT="ttyLP0"
BR2_TARGET_GENERIC_ROOT_PASSWD="root"
BR2_SYSTEM_DHCP="eth0"
BR2_SYSTEM_DEFAULT_PATH="/bin:/sbin:/usr/bin:/usr/sbin:/opt/bin:/opt/sbin"
BR2_ROOTFS_POST_BUILD_SCRIPT="board/arcturus/aarch64-ucimx93/post-build.sh"
BR2_ROOTFS_POST_IMAGE_SCRIPT="board/arcturus/aarch64-ucimx93/post-image.sh"
BR2_ROOTFS_POST_SCRIPT_ARGS="br2-ucimx93-som144.its"
BR2_LINUX_KERNEL=y
BR2_LINUX_KERNEL_CUSTOM_TARBALL=y
BR2_LINUX_KERNEL_CUSTOM_TARBALL_LOCATION="$(call github,ArcturusNetworks,uCLS1012A-kernel,v240906)/linux.tar.gz"
BR2_LINUX_KERNEL_DEFCONFIG="ucimx93-som144"
BR2_LINUX_KERNEL_IMAGEGZ=y
BR2_LINUX_KERNEL_DTS_SUPPORT=y
BR2_LINUX_KERNEL_INTREE_DTS_NAME="arcturus/ucimx93-som144 arcturus/ucimx93-som144-tsdc11 arcturus/ucimx93-som144-ucevo10 arcturus/ucimx93-som144-ucevo20"
BR2_LINUX_KERNEL_NEEDS_HOST_OPENSSL=y
BR2_PACKAGE_STRACE=y
BR2_PACKAGE_MMC_UTILS=y
BR2_PACKAGE_FREESCALE_IMX=y
BR2_PACKAGE_FREESCALE_IMX_PLATFORM_IMX93=y
BR2_PACKAGE_FIRMWARE_IMX=y
BR2_PACKAGE_READLINE=y
BR2_PACKAGE_APACHE=y
BR2_PACKAGE_MJPG_STREAMER=y
BR2_PACKAGE_MC=y
BR2_TARGET_ROOTFS_CPIO=y
BR2_TARGET_ROOTFS_CPIO_GZIP=y
BR2_TARGET_ROOTFS_CPIO_UIMAGE=y
BR2_TARGET_ARM_TRUSTED_FIRMWARE=y
BR2_TARGET_ARM_TRUSTED_FIRMWARE_CUSTOM_TARBALL=y
BR2_TARGET_ARM_TRUSTED_FIRMWARE_CUSTOM_TARBALL_LOCATION="$(call github,nxp-imx,imx-atf,lf-6.1.22-2.0.0)/imx-atf-lf-6.1.22-2.0.0.tar.gz"
BR2_TARGET_ARM_TRUSTED_FIRMWARE_PLATFORM="imx93"
BR2_TARGET_ARM_TRUSTED_FIRMWARE_BL31=y
BR2_TARGET_UBOOT=y
BR2_TARGET_UBOOT_BUILD_SYSTEM_KCONFIG=y
BR2_TARGET_UBOOT_CUSTOM_HG=y
BR2_TARGET_UBOOT_CUSTOM_REPO_URL="ssh://hgssh@fatman.arcturusnetworks.com/u-boot-imx9.devel"
BR2_TARGET_UBOOT_CUSTOM_REPO_VERSION="v20240618"
BR2_TARGET_UBOOT_USE_CUSTOM_CONFIG=y
BR2_TARGET_UBOOT_CUSTOM_CONFIG_FILE="board/arcturus/aarch64-ucmx93/uboot-UCMX93_SOM144_defconfig"
BR2_TARGET_UBOOT_NEEDS_DTC=y
BR2_TARGET_UBOOT_NEEDS_OPENSSL=y
BR2_TARGET_UBOOT_SPL=y
BR2_PACKAGE_HOST_DOSFSTOOLS=y
BR2_PACKAGE_HOST_E2FSPROGS=y
BR2_PACKAGE_HOST_GENIMAGE=y
BR2_PACKAGE_HOST_IMX_MKIMAGE=y
BR2_PACKAGE_HOST_MTOOLS=y
BR2_PACKAGE_HOST_UBOOT_TOOLS_FIT_SUPPORT=y
```

## configs/arcturus_ucls1012a_dongle_defconfig
```kconfig
BR2_aarch64=y
BR2_WGET="wget -nd -t 3 --no-check-certificate"
BR2_DL_DIR="$(TOPDIR)/.dl"
BR2_INIT_NONE=y
# BR2_PACKAGE_BUSYBOX is not set
# BR2_TARGET_ROOTFS_TAR is not set
BR2_TARGET_UBOOT=y
BR2_TARGET_UBOOT_BUILD_SYSTEM_KCONFIG=y
BR2_TARGET_UBOOT_CUSTOM_HG=y
BR2_TARGET_UBOOT_CUSTOM_REPO_URL="ssh://hgssh@fatman.arcturusnetworks.com/u-boot-ls1012a.pit"
BR2_TARGET_UBOOT_CUSTOM_REPO_VERSION="v240926"
BR2_TARGET_UBOOT_BOARD_DEFCONFIG="UCLS1012A_DONGLE"
```

## configs/arcturus_ucls1012a_som120_T1_defconfig
```kconfig
BR2_aarch64=y
BR2_PACKAGE_HOST_LINUX_HEADERS_CUSTOM_6_1=y
BR2_WGET="wget -nd -t 3 --no-check-certificate"
BR2_DL_DIR="$(TOPDIR)/.BR2_dl"
BR2_TARGET_GENERIC_HOSTNAME="ucls1012a"
BR2_TARGET_GENERIC_ISSUE="Welcome to uCLS1012A-SOM120"
BR2_SYSTEM_DHCP="eth0"
BR2_SYSTEM_DEFAULT_PATH="/bin:/sbin:/usr/bin:/usr/sbin:/opt/bin:/opt/sbin"
BR2_ROOTFS_OVERLAY="board/arcturus/aarch64-ucls1012a/rootfs_overlay"
BR2_ROOTFS_POST_BUILD_SCRIPT="board/arcturus/aarch64-ucls1012a/som120/post-build.sh"
BR2_ROOTFS_POST_IMAGE_SCRIPT="board/arcturus/aarch64-ucls1012a/som120/post-image.sh"
BR2_LINUX_KERNEL=y
BR2_LINUX_KERNEL_CUSTOM_TARBALL=y
BR2_LINUX_KERNEL_CUSTOM_TARBALL_LOCATION="$(call github,ArcturusNetworks,uCLS1012A-kernel,v240829)/linux.tar.gz"
BR2_LINUX_KERNEL_DEFCONFIG="ucls1012a-som120"
BR2_LINUX_KERNEL_IMAGEGZ=y
BR2_LINUX_KERNEL_DTS_SUPPORT=y
BR2_LINUX_KERNEL_INTREE_DTS_NAME="arcturus/arc-ucls1012a-som120"
BR2_TARGET_ROOTFS_CPIO=y
BR2_TARGET_ROOTFS_CPIO_GZIP=y
BR2_TARGET_ROOTFS_CRAMFS=y
BR2_TARGET_ROOTFS_CRAMFS_XIP=y
BR2_TARGET_ROOTFS_JFFS2=y
BR2_TARGET_ROOTFS_JFFS2_FLASH_64=y
BR2_TARGET_ROOTFS_JFFS2_NOCLEANMARKER=y
BR2_TARGET_ROOTFS_JFFS2_PAD=y
BR2_TARGET_ROOTFS_JFFS2_SUMMARY=y
BR2_TARGET_ROOTFS_SQUASHFS=y
BR2_TARGET_UBOOT=y
BR2_TARGET_UBOOT_BUILD_SYSTEM_KCONFIG=y
BR2_TARGET_UBOOT_CUSTOM_TARBALL=y
BR2_TARGET_UBOOT_CUSTOM_TARBALL_LOCATION="$(call github,ArcturusNetworks,uCLS1012A-uboot,v240903)/uboot.tar.gz"
BR2_TARGET_UBOOT_BOARD_DEFCONFIG="UCLS1012A_SOM120_T1"
BR2_PACKAGE_HOST_UBOOT_TOOLS=y
BR2_PACKAGE_HOST_UBOOT_TOOLS_FIT_SUPPORT=y
```

## configs/arcturus_ucls1012a_som314s_defconfig
```kconfig
# Architecture
BR2_aarch64=y

# System settings
BR2_PACKAGE_HOST_LINUX_HEADERS_CUSTOM_6_1=y
BR2_DL_DIR="$(TOPDIR)/.dl"
BR2_TARGET_GENERIC_HOSTNAME="ucls1012a"
BR2_TARGET_GENERIC_ISSUE="Welcome to uCLS1012A-SOM314S (Smarc)"
BR2_SYSTEM_DHCP="eth0"
BR2_ROOTFS_POST_BUILD_SCRIPT="board/arcturus/aarch64-ucls1012a/som314s/post-build.sh"
BR2_ROOTFS_POST_IMAGE_SCRIPT="board/arcturus/aarch64-ucls1012a/som314s/post-image.sh"
BR2_ROOTFS_POST_SCRIPT_ARGS="br_som314s_002" # Has to be the same as BR2_LINUX_KERNEL_CUSTOM_REPO_VERSION

# Kernel
BR2_LINUX_KERNEL=y
BR2_LINUX_KERNEL_CUSTOM_GIT=y
BR2_LINUX_KERNEL_CUSTOM_REPO_URL="https://github.com/ArcturusNetworks/uCLS1012A-kernel"
BR2_LINUX_KERNEL_CUSTOM_REPO_VERSION="br_som314s_002"
BR2_LINUX_KERNEL_DEFCONFIG="ucls1012a-som314s"
BR2_LINUX_KERNEL_IMAGEGZ=y
BR2_LINUX_KERNEL_DTS_SUPPORT=y
BR2_LINUX_KERNEL_INTREE_DTS_NAME="arcturus/arc-ucls1012a-som314s"

# Filesystem
BR2_TARGET_ROOTFS_CPIO=y
BR2_TARGET_ROOTFS_CPIO_GZIP=y

# U-boot
BR2_TARGET_UBOOT=y
BR2_TARGET_UBOOT_BUILD_SYSTEM_KCONFIG=y
BR2_TARGET_UBOOT_CUSTOM_GIT=y
BR2_TARGET_UBOOT_CUSTOM_REPO_URL="https://github.com/ArcturusNetworks/uCLS1012A-uboot"
BR2_TARGET_UBOOT_CUSTOM_REPO_VERSION="br_som314s_002"
BR2_TARGET_UBOOT_BOARD_DEFCONFIG="UCLS1012A_SOM314S"

# Tools
BR2_PACKAGE_HOST_UBOOT_TOOLS=y
BR2_PACKAGE_HOST_UBOOT_TOOLS_FIT_SUPPORT=y
```

## configs/arcturus_ucls1012a_som_defconfig
```kconfig
# Architecture
BR2_aarch64=y

BR2_DL_DIR="$(TOPDIR)/.dl"
BR2_PACKAGE_HOST_LINUX_HEADERS_CUSTOM_5_4=y

# System settings
BR2_TOOLCHAIN_BUILDROOT_CXX=y
BR2_TARGET_GENERIC_HOSTNAME="ucls1012a"
BR2_TARGET_GENERIC_ISSUE="Welcome to uCLS1012A-SOM"
BR2_TARGET_GENERIC_ROOT_PASSWD="admin"
BR2_SYSTEM_DHCP="eth0"
BR2_SYSTEM_DEFAULT_PATH="/bin:/sbin:/usr/bin:/usr/sbin:/opt/bin:/opt/sbin"
BR2_ROOTFS_OVERLAY="board/arcturus/aarch64-ucls1012a/rootfs_overlay"
BR2_ROOTFS_POST_BUILD_SCRIPT="board/arcturus/aarch64-ucls1012a/som/post-build.sh"
BR2_ROOTFS_POST_IMAGE_SCRIPT="board/arcturus/aarch64-ucls1012a/som/post-image.sh"

# Kernel
BR2_LINUX_KERNEL=y
BR2_LINUX_KERNEL_CUSTOM_TARBALL=y
BR2_LINUX_KERNEL_CUSTOM_TARBALL_LOCATION="$(call github,ArcturusNetworks,uCLS1012A-kernel,latest)/linux.tar.gz"
BR2_LINUX_KERNEL_DEFCONFIG="ucls1012a_som"
BR2_LINUX_KERNEL_IMAGEGZ=y
BR2_LINUX_KERNEL_DTS_SUPPORT=y
BR2_LINUX_KERNEL_INTREE_DTS_NAME="arcturus/ucls1012a-som"

# Filesystem
BR2_TARGET_ROOTFS_CPIO=y
BR2_TARGET_ROOTFS_CPIO_GZIP=y
BR2_TARGET_ROOTFS_CRAMFS=y
BR2_TARGET_ROOTFS_CRAMFS_XIP=y
BR2_TARGET_ROOTFS_JFFS2=y
BR2_TARGET_ROOTFS_JFFS2_FLASH_64=y
BR2_TARGET_ROOTFS_JFFS2_NOCLEANMARKER=y
BR2_TARGET_ROOTFS_JFFS2_PAD=y
BR2_TARGET_ROOTFS_JFFS2_SUMMARY=y
BR2_TARGET_ROOTFS_SQUASHFS=y

# U-boot
BR2_TARGET_UBOOT=y
BR2_TARGET_UBOOT_BUILD_SYSTEM_KCONFIG=y
BR2_TARGET_UBOOT_CUSTOM_TARBALL=y
BR2_TARGET_UBOOT_CUSTOM_TARBALL_LOCATION="$(call github,ArcturusNetworks,uCLS1012A-uboot,latest)/uboot.tar.gz"
BR2_TARGET_UBOOT_BOARD_DEFCONFIG="UCLS1012A_SOM"

# Tools
BR2_PACKAGE_HOST_UBOOT_TOOLS=y
BR2_PACKAGE_HOST_UBOOT_TOOLS_FIT_SUPPORT=y
```

## configs/arcturus_ucs32v_som_defconfig
```kconfig
# Architecture
BR2_aarch64=y

# Toolchain
BR2_TOOLCHAIN_EXTERNAL=y

# System settings
BR2_TARGET_GENERIC_HOSTNAME="ucs32v"
BR2_TARGET_GENERIC_ISSUE="Welcome to uCS32V234-SOM"
BR2_SYSTEM_DHCP="eth0"
BR2_ROOTFS_POST_IMAGE_SCRIPT="board/arcturus/aarch64-ucs32v/post-image.sh"

# Kernel
BR2_LINUX_KERNEL=y
BR2_LINUX_KERNEL_CUSTOM_GIT=y
BR2_LINUX_KERNEL_CUSTOM_REPO_URL="https://github.com/ArcturusNetworks/uCS32V-kernel.git"
BR2_LINUX_KERNEL_CUSTOM_REPO_VERSION="747b22c1b6d93f04ee87cd838213811e8dfd5531"
BR2_LINUX_KERNEL_DEFCONFIG="s32v234"
BR2_LINUX_KERNEL_DTS_SUPPORT=y
BR2_LINUX_KERNEL_INTREE_DTS_NAME="freescale/s32v234-evb"

# Filesystem
BR2_TARGET_ROOTFS_CPIO=y
BR2_TARGET_ROOTFS_CPIO_GZIP=y

# U-boot
BR2_TARGET_UBOOT=y
BR2_TARGET_UBOOT_BUILD_SYSTEM_KCONFIG=y
BR2_TARGET_UBOOT_CUSTOM_GIT=y
BR2_TARGET_UBOOT_CUSTOM_REPO_URL="https://github.com/ArcturusNetworks/uCS32V-uboot.git"
BR2_TARGET_UBOOT_CUSTOM_REPO_VERSION="7debd6074dfd91dd6a22f207b3f8cdd20af87202"
BR2_TARGET_UBOOT_BOARD_DEFCONFIG="s32v234evb"

# Tools
BR2_PACKAGE_HOST_UBOOT_TOOLS=y
BR2_PACKAGE_HOST_UBOOT_TOOLS_FIT_SUPPORT=y
```

## configs/arcturus_ucs32v_som_glibc_defconfig
```kconfig
# Architecture
BR2_aarch64=y
BR2_TOOLCHAIN_BUILDROOT_GLIBC=y

# Linux headers same as kernel, a 4.1 series
BR2_PACKAGE_HOST_LINUX_HEADERS_CUSTOM_4_1=y

# System settings
BR2_TOOLCHAIN_BUILDROOT_CXX=y
BR2_TARGET_GENERIC_HOSTNAME="uCs32v234"
BR2_TARGET_GENERIC_ISSUE="Welcome to uCS32V234-SOM"
BR2_SYSTEM_DHCP="eth0"
BR2_ROOTFS_POST_IMAGE_SCRIPT="board/arcturus/aarch64-ucs32v/post-image.sh"

# Kernel
BR2_LINUX_KERNEL=y
BR2_LINUX_KERNEL_CUSTOM_GIT=y
BR2_LINUX_KERNEL_CUSTOM_REPO_URL="https://github.com/ArcturusNetworks/uCS32V-kernel.git"
BR2_LINUX_KERNEL_CUSTOM_REPO_VERSION="v0.3.1814"
BR2_LINUX_KERNEL_DEFCONFIG="s32v234"
BR2_LINUX_KERNEL_DTS_SUPPORT=y
BR2_LINUX_KERNEL_INTREE_DTS_NAME="freescale/s32v234sbc"

# Filesystem
BR2_TARGET_ROOTFS_CPIO=y
BR2_TARGET_ROOTFS_CPIO_GZIP=y

# U-boot
BR2_TARGET_UBOOT=y
BR2_TARGET_UBOOT_BUILD_SYSTEM_KCONFIG=y
BR2_TARGET_UBOOT_CUSTOM_GIT=y
BR2_TARGET_UBOOT_CUSTOM_REPO_URL="https://github.com/ArcturusNetworks/uCS32V-uboot.git"
BR2_TARGET_UBOOT_CUSTOM_REPO_VERSION="v0.3.1814"
BR2_TARGET_UBOOT_BOARD_DEFCONFIG="s32v234sbc"
# BR2_TARGET_UBOOT_FORMAT_BIN is not set
BR2_TARGET_UBOOT_FORMAT_CUSTOM=y
BR2_TARGET_UBOOT_FORMAT_CUSTOM_NAME="u-boot.s32"

# Tools
BR2_PACKAGE_HOST_UBOOT_TOOLS=y
BR2_PACKAGE_HOST_UBOOT_TOOLS_FIT_SUPPORT=y
```
